## boards/shields/charybdis3m/Kconfig.defconfig
```kconfig
if SHIELD_CHARYBDIS3M_CENTRAL

config ZMK_KEYBOARD_NAME
	default "Charybdis3M_X"

config ZMK_SPLIT
	default y

config ZMK_SPLIT_BLE_ROLE_CENTRAL
	default y


config ZMK_SPLIT_BLE_CENTRAL_PERIPHERALS
	default 2

endif

if SHIELD_CHARYBDIS3M_LEFT || SHIELD_CHARYBDIS3M_RIGHT

config ZMK_SPLIT
	default y

config ZMK_SPLIT_BLE
	default y

endif
```

## boards/shields/charybdis3m/Kconfig.shield
```kconfig
config SHIELD_CHARYBDIS3M_LEFT
    def_bool $(shields_list_contains,charybdis3m_left)

config SHIELD_CHARYBDIS3M_RIGHT
    def_bool $(shields_list_contains,charybdis3m_right)
```
